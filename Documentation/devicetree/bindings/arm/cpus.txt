## arch/arm/mach-multi/Kconfig
```kconfig
menu "Multiple platform selection"
	depends on ARCH_MULTIPLATFORM

comment "CPU Core family selection"

config ARCH_MULTI_V4
	bool "ARMv4 based platforms (FA526, StrongARM)"
	select ARCH_MULTI_V4_V5
	depends on !ARCH_MULTI_V6_V7

config ARCH_MULTI_V4T
	bool "ARMv4T based platforms (ARM720T, ARM920T, ...)"
	select ARCH_MULTI_V4_V5
	depends on !ARCH_MULTI_V6_V7

config ARCH_MULTI_V5
	bool "ARMv5 based platforms (ARM926T, XSCALE, PJ1, ...)"
	select ARCH_MULTI_V4_V5
	depends on !ARCH_MULTI_V6_V7

config ARCH_MULTI_V4_V5
	bool

config ARCH_MULTI_V6
	bool "ARMv6 based platforms (ARM11, Scorpion, ...)"
	select ARCH_MULTI_V6_V7

config ARCH_MULTI_V7
	bool "ARMv7 based platforms (Cortex-A, PJ4, Krait)"
	default y
	select ARCH_MULTI_V6_V7

config ARCH_MULTI_V6_V7
	bool

config ARCH_MULTI_CPU_AUTO
	def_bool !(ARCH_MULTI_V4 || ARCH_MULTI_V4T || ARCH_MULTI_V6_V7)
	select ARCH_MULTI_V5

comment "SoC family selection"
config ARCH_MULTI_OMAP2PLUS
	bool
	select ARCH_OMAP
	select ARCH_OMAP2PLUS
        select HAVE_CLK
        select ARCH_REQUIRE_GPIOLIB
        select ARCH_HAS_CPUFREQ
        select CLKSRC_MMIO
        select GENERIC_CLOCKEVENTS
        select ARCH_HAS_HOLES_MEMORYMODEL
        select CLKDEV_LOOKUP
        select GENERIC_IRQ_CHIP
        select OMAP_DM_TIMER
        select SERIAL_OMAP
        select SERIAL_OMAP_CONSOLE
        select I2C
        select I2C_OMAP
        select MENELAUS if ARCH_OMAP2
        select TWL4030_CORE if ARCH_OMAP3 || ARCH_OMAP4
        select TWL4030_POWER if ARCH_OMAP3 || ARCH_OMAP4
	select MACH_OMAP_GENERIC

config ARCH_MULTI_OMAP2
	bool "Texas Instruments OMAP2"
	depends on ARCH_MULTI_V6
	select ARCH_OMAP
	select ARCH_OMAP2PLUS
	select ARCH_MULTI_OMAP2PLUS
	select ARCH_OMAP2
	select SOC_OMAP2420
	select SOC_OMAP2430

config ARCH_MULTI_OMAP3
	bool "Texas Instruments OMAP3"
	depends on ARCH_MULTI_V7
	select ARCH_MULTI_OMAP2PLUS
	select ARCH_OMAP3
	select SOC_OMAP3430
	select SOC_OMAPTI81XX
	select SOC_OMAPAM33XX

config ARCH_MULTI_OMAP4
	bool "Texas Instruments OMAP4"
	depends on ARCH_MULTI_V7
	select ARCH_MULTI_OMAP2PLUS
	select ARCH_OMAP4

config ARCH_MULTI_UX500
	bool "ST-Ericsson U8500"
	depends on ARCH_MULTI_V7
	select ARCH_U8500
	select MACH_MOP500
	select MACH_UX500_DT

config ARCH_MULTI_IMX
	bool
	select ARCH_MXC

config ARCH_MULTI_IMX51
	bool "Freescale i.MX51"
	depends on ARCH_MULTI_V7
	select ARCH_MULTI_IMX
	select ARCH_IMX_V6_V7
	select MACH_IMX51_DT

config ARCH_MULTI_IMX53
	bool "Freescale i.MX53"
	depends on ARCH_MULTI_V7
	select ARCH_MULTI_IMX
	select ARCH_IMX_V6_V7
	select MACH_IMX53_DT

config ARCH_MULTI_IMX6
	bool "Freescale i.MX6Q"
	depends on ARCH_MULTI_V7
	select ARCH_MULTI_IMX
	select ARCH_IMX_V6_V7
	select SOC_IMX6Q

config ARCH_MULTI_AUTOSELECT
	def_bool y
	depends on !ARCH_MULTI_OMAP2PLUS
	depends on !ARCH_MULTI_UX500
	depends on !ARCH_MXC
	select ARCH_MULTI_VEXPRESS

config ARCH_MULTI_VEXPRESS
	bool "ARM Ltd. Versatile Express family"
	depends on ARCH_MULTI_V7
	select ARCH_VEXPRESS
	select ARCH_VEXPRESS_DT
	select ARCH_VEXPRESS_CA9X4
	select ARCH_WANT_OPTIONAL_GPIOLIB
	select ARM_AMBA
	select ARM_TIMER_SP804
	select CLKDEV_LOOKUP
	select GENERIC_CLOCKEVENTS
	select HAVE_CLK
	select HAVE_PATA_PLATFORM
	select ICST
	select PLAT_VERSATILE
	select PLAT_VERSATILE_CLCD

endmenu
```

## drivers/media/video/samsung/Kconfig
```kconfig
config VIDEO_SAMSUNG
	bool "Samsung Multimedia Devices - Internal"
	depends on VIDEO_CAPTURE_DRIVERS && VIDEO_V4L2
	select VIDEO_FIXED_MINOR_RANGES
	default n
	help
	  This is a representative video4linux configuration for Samsung multimedia devices.

source "drivers/media/video/samsung/jpeg/Kconfig"

if VIDEO_SAMSUNG
comment "Reserved memory configurations"
config VIDEO_SAMSUNG_MEMSIZE_JPEG
	int "Memory size in kbytes for JPEG"
	depends on VIDEO_JPEG
	default "24576"
endif
```

## drivers/net/wireless/ath/ath6kl/Kconfig
```kconfig
config ATH6KL
	tristate "Atheros ath6kl support"
	depends on MMC
	depends on CFG80211
	---help---
	  This module adds support for wireless adapters based on
	  Atheros AR6003 chipset running over SDIO. If you choose to
	  build it as a module, it will be called ath6kl. Pls note
	  that AR6002 and AR6001 are not supported by this driver.

config ATH6KL_DEBUG
	bool "Atheros ath6kl debugging"
	depends on ATH6KL
	---help---
	  Enables debug support

config ATH6KL_SDIO_POLL
        bool "Atheros ath6kl debugging with SDIO polling"
        depends on ATH6KL
        ---help---
          Enables SDIO polling for debugging when SDIO's problem
          happens. This is tested only with HW2.0. By default
          polling time interval is 10ms
```

## drivers/net/wireless/ti/wl18xx/Kconfig
```kconfig
config WL18XX
       tristate "TI wl18xx support"
       select WLCORE
       select WIRELESS_EXT

       ---help---
	  This module adds support for wireless adapters based on TI
	  WiLink 8 chipsets.
```

## drivers/scsi/ufs/Kconfig
```kconfig
#
# Kernel configuration file for the UFS Host Controller
#
# This code is based on drivers/scsi/ufs/Kconfig
# Copyright (C) 2011  Samsung Samsung India Software Operations
#
# Santosh Yaraganavi <santosh.sy@samsung.com>
# Vinayak Holikatti <h.vinayak@samsung.com>

# This program is free software; you can redistribute it and/or
# modify it under the terms of the GNU General Public License
# as published by the Free Software Foundation; either version 2
# of the License, or (at your option) any later version.

# This program is distributed in the hope that it will be useful,
# but WITHOUT ANY WARRANTY; without even the implied warranty of
# MERCHANTABILITY or FITNESS FOR A PARTICULAR PURPOSE.  See the
# GNU General Public License for more details.

# NO WARRANTY
# THE PROGRAM IS PROVIDED ON AN "AS IS" BASIS, WITHOUT WARRANTIES OR
# CONDITIONS OF ANY KIND, EITHER EXPRESS OR IMPLIED INCLUDING, WITHOUT
# LIMITATION, ANY WARRANTIES OR CONDITIONS OF TITLE, NON-INFRINGEMENT,
# MERCHANTABILITY OR FITNESS FOR A PARTICULAR PURPOSE. Each Recipient is
# solely responsible for determining the appropriateness of using and
# distributing the Program and assumes all risks associated with its
# exercise of rights under this Agreement, including but not limited to
# the risks and costs of program errors, damage to or loss of data,
# programs or equipment, and unavailability or interruption of operations.

# DISCLAIMER OF LIABILITY
# NEITHER RECIPIENT NOR ANY CONTRIBUTORS SHALL HAVE ANY LIABILITY FOR ANY
# DIRECT, INDIRECT, INCIDENTAL, SPECIAL, EXEMPLARY, OR CONSEQUENTIAL
# DAMAGES (INCLUDING WITHOUT LIMITATION LOST PROFITS), HOWEVER CAUSED AND
# ON ANY THEORY OF LIABILITY, WHETHER IN CONTRACT, STRICT LIABILITY, OR
# TORT (INCLUDING NEGLIGENCE OR OTHERWISE) ARISING IN ANY WAY OUT OF THE
# USE OR DISTRIBUTION OF THE PROGRAM OR THE EXERCISE OF ANY RIGHTS GRANTED
# HEREUNDER, EVEN IF ADVISED OF THE POSSIBILITY OF SUCH DAMAGES

# You should have received a copy of the GNU General Public License
# along with this program; if not, write to the Free Software
# Foundation, Inc., 51 Franklin Street, Fifth Floor, Boston, MA  02110-1301,
# USA.

config SCSI_UFSHCD
	tristate "Universal Flash Storage host controller driver"
	depends on SCSI
	---help---
	This is a generic driver which supports UFS Host controllers.
	This option is selected automatically if the SCSI option is
	selected. This is a core ufs driver.

config SCSI_UFSHCD_PCI
	tristate "Universal Flash Storage host support on PCI bus"
	depends on SCSI_UFSHCD && PCI
	---help---
	This selects the PCI bus for the Universal Flash Storage IP.
	Select this option if the IP is present on PCI platform.

	If you have a controller with this interface, say Y or M here.

	If unsure, say N.

config SCSI_UFSHCD_PLTFM
	tristate "Universal Flash Storage host support as platform device"
	depends on SCSI_UFSHCD
	help
	This selects the common helper functions support for Host Controller
	Interface based platform driver. Please select this option if the IP
	is present as a platform device. This is the common interface for the
	UFS Host Controller IP.

	If you have a controller with this interface, say Y or M here.

	If unsure, say N.
```
